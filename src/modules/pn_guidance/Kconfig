## src/modules/pn_guidance/Kconfig
```kconfig
config MODULES_PN_GUIDANCE
	bool "PN Guidance"
	default y
	help
		Proportional Navigation guidance module.
		Receives target LOS angular velocity and generates guidance commands.
```
